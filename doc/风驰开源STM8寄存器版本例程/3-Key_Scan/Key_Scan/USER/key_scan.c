/******************** (C) COPYRIGHT  风驰iCreate嵌入式开发工作室 ***************************
 * 文件名  ：key_scan.c
 * 描述    ：按键配置函数库   
 * 实验平台：iCreate STM8开发板
 * 库版本  ：V2.0.0
 * 作者    ：ling_guansheng  QQ：779814207
 * 博客    ：
 *修改时间 ：2011-12-20

  iCreate STM8开发板硬件连接
    |--------------------|
    |  Buttom1-PD5       |
    |  Buttom2-PD6       |
    |  Buttom3-PD7       |
    |--------------------|

****************************************************************************************/
#include "key_scan.h"
static void Delay(u16 nCount);
/**************************************************************************
 * 函数名：Buttom_conf
 * 描述  ：按键配置函数
 * 输入  ：无
 *
 * 输出  ：无
 * 返回  ：无 
 * 调用  ：外部调用 
 *************************************************************************/
void Buttom_conf(void)
{
  PD_DDR&=0x1f;/*设置数据方向寄存器 1为输出，0为输入*/
  PD_CR1|=0xe0;/*设置上拉输入*/
  PD_CR2&=0x1f;/*设置无中断*/
}
/**************************************************************************
 * 函数名：Key_Scan
 * 描述  ：按键扫描函数
 * 输入  ：无
 *
 * 输出  ：无
 * 返回  ：按键状态 Buttom_OFF标志没按键按下，Buttom_ON表示有按键按下
 * 调用  ：外部调用 
 *************************************************************************/
BitStatus Key_Scan(void)
{
    BitStatus ButtomStatus;
    ButtomStatus=Buttom_OFF;
    if(!PD5_In)
    {
        Delay(0x3ff);/*  消抖 */
        if(!PD5_In)
        {
          while(!PD5_In);/*松手释放*/
          ButtomStatus=Buttom_ON;
        }
    }
    return ButtomStatus;
}
/**************************************************************************
 * 函数名：Delay
 * 描述  ：按键扫描函数
 * 输入  ：无
 *
 * 输出  ：无
 * 返回  ：无
 * 调用  ：内部调用 
 *************************************************************************/
static void Delay(u16 nCount)
{
  /* Decrement nCount value */
  while (nCount != 0)
  {
    nCount--;
  }

}
/******************* (C) COPYRIGHT 风驰iCreate嵌入式开发工作室 *****END OF FILE****/
