/**************************************************
 *
 * Extern declarations of the virtual registers.
 *
 * Copyright 2010 IAR Systems AB.
 *
 * $Revision: 2075 $
 *
 **************************************************/

#ifndef VREGS_INC
#define VREGS_INC

        EXTERN  ?b0
        EXTERN  ?b1
        EXTERN  ?b2
        EXTERN  ?b3
        EXTERN  ?b4
        EXTERN  ?b5
        EXTERN  ?b6
        EXTERN  ?b7
        EXTERN  ?b8
        EXTERN  ?b9
        EXTERN  ?b10
        EXTERN  ?b11
        EXTERN  ?b12
        EXTERN  ?b13
        EXTERN  ?b14
        EXTERN  ?b15

        EXTERN  ?w0
        EXTERN  ?w1
        EXTERN  ?w2
        EXTERN  ?w3
        EXTERN  ?w4
        EXTERN  ?w5
        EXTERN  ?w6
        EXTERN  ?w7

        EXTERN  ?l0
        EXTERN  ?l1
        EXTERN  ?l2
        EXTERN  ?l3

        EXTERN  ?e0
        EXTERN  ?e1
        EXTERN  ?e2
        EXTERN  ?e3

#endif /* VREGS_INC */
